#define INTERRUPT 0
#define DEBUG 0
#if DEBUG
  #define debug(x) Serial.print(x)
  #define debugln(x) Serial.println(x)
  #define beginSerial() Serial.begin(9600)
#else
  #define debug(x)
  #define debugln(x)
  #define beginSerial()
#endif
#include "DHT.h"
#include <SPI.h>
#include <Wire.h>
#include <Adafruit_GFX.h>
#include <Adafruit_SSD1306.h>
#include <ACROBOTIC_SSD1306.h>
#include <EEPROM.h>
#include <I2CAddress.h>

#define DHT11Pin 2
DHT dht;
int counter = 0;
bool sendData = false;
bool onBattery = false;
const byte PROGMEM buttonOkPin = A2; 
const byte PROGMEM buttonLeftPin = A1; 
const byte PROGMEM buttonRightPin = A3; 

byte dhtError = 0;
byte countHeaterStatus = 0;
byte countVentStatus = 0;
int MenuState = 0;
unsigned long prevMillis;
unsigned long prevMillisOfStatus;

const int PROGMEM maxTempLimit = 80;
const int PROGMEM minTempLimit = -10;
const int PROGMEM maxHumLimit = 90;

byte tempDHT = 0;
byte humDHT = 0;
const byte PROGMEM maxtempaddr = 0;
const byte PROGMEM mintempaddr = 1;
const byte PROGMEM maxhumaddr = 2;
const byte PROGMEM setByAmountAddr = 3;
const byte PROGMEM heaterSetting = 4;
const byte PROGMEM coolerSetting = 5;
byte buttonState = 0;
char cstr[16];

byte maxtemp = EEPROM.read(maxtempaddr);
byte mintemp = EEPROM.read(mintempaddr);
byte maxhum = EEPROM.read(maxhumaddr);
byte setByAmount = EEPROM.read(setByAmountAddr);

const byte PROGMEM heaterSwitch = 7;
const byte PROGMEM ventSwitch = 8;
const byte PROGMEM heater = 6;
const byte PROGMEM vent = 5;
const byte PROGMEM poplava = A0;

bool heaterManual = false;
bool coolerManual = false;

static const unsigned char PROGMEM heater_on[] =
    {0x00, 0x00, 0x00, 0x00, 0x00, 0x00, 0x00, 0x00, 0x00, 0x00, 0x00, 0x00, 0x00, 0x00, 0x00, 0x00,
0x00, 0x00, 0x00, 0x00, 0x00, 0x00, 0x00, 0x00, 0x00, 0x00, 0x00, 0x00, 0x00, 0x00, 0x00, 0x00,
0x00, 0x00, 0x00, 0x00, 0x00, 0x00, 0x00, 0x00, 0x00, 0x00, 0x00, 0x00, 0x00, 0x00, 0x00, 0x00,
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0x00, 0x00, 0x00, 0x00, 0x00, 0x00, 0x00, 0x00, 0x00, 0x00, 0x00, 0x00, 0x00, 0x00, 0x00, 0x00};

static const unsigned char PROGMEM vent_on[] = {
    0x00, 0x00, 0x00, 0x00, 0x00, 0x00, 0x00, 0x00, 0x00, 0x00, 0x00, 0x00, 0x00, 0x00, 0x00, 0x00,
0x00, 0x00, 0x00, 0x00, 0x00, 0x00, 0x00, 0x00, 0x00, 0x00, 0x00, 0x00, 0x00, 0x00, 0x00, 0x00,
0x00, 0x00, 0x00, 0x00, 0x00, 0x00, 0x00, 0x00, 0x00, 0x00, 0x00, 0x00, 0x00, 0x00, 0x00, 0x00,
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0x00, 0x00, 0x00, 0x00, 0x00, 0x00, 0x00, 0x00, 0x00, 0x00, 0x00, 0x00, 0x00, 0x00, 0x00, 0x00};

static const unsigned char PROGMEM nothing[] = {
    0x00, 0x00, 0x00, 0x00, 0x00, 0x00, 0x00, 0x00, 0x00, 0x00, 0x00, 0x00, 0x00, 0x00, 0x00, 0x00,
0x00, 0x00, 0x00, 0x00, 0x00, 0x00, 0x00, 0x00, 0x00, 0x00, 0x00, 0x00, 0x00, 0x00, 0x00, 0x00,
0x00, 0x00, 0x00, 0x0E, 0x1B, 0x1D, 0x15, 0x1E, 0x0C, 0x0C, 0x0C, 0x0C, 0x1F, 0xF5, 0xFD, 0x1F,
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0x00, 0x00, 0x00, 0x00, 0x00, 0x00, 0x00, 0x00, 0x00, 0x00, 0x00, 0x00, 0x00, 0x00, 0x00, 0x00};

static const unsigned char PROGMEM sending[] = {
    0x00, 0x00, 0x00, 0x00, 0x00, 0x00, 0x00, 0x00, 0x00, 0x00, 0x00, 0x00, 0x00, 0x00, 0x00, 0x00,
0x00, 0x00, 0x00, 0x00, 0x00, 0x00, 0x00, 0x00, 0x00, 0x00, 0x00, 0x00, 0x00, 0x00, 0x00, 0x00,
0x00, 0x00, 0x00, 0x00, 0x00, 0x00, 0x00, 0x00, 0x00, 0x00, 0x00, 0x00, 0x00, 0x00, 0x00, 0x00,
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0x00, 0x00, 0x00, 0x00, 0x00, 0x00, 0x00, 0x00, 0x00, 0x00, 0x00, 0x00, 0x00, 0x00, 0x00, 0x00};

static const unsigned char PROGMEM battery[] = {
  0x00, 0x00, 0x00, 0x00, 0x00, 0x00, 0x00, 0x00, 0x00, 0x00, 0x00, 0x00, 0x00, 0x00, 0x00, 0x00,
0x00, 0x80, 0x80, 0x80, 0xC0, 0xC0, 0xC0, 0xC0, 0xC0, 0xC0, 0xC0, 0xC0, 0xC0, 0xC0, 0xC0, 0xC0,
0xC0, 0xC0, 0xC0, 0xC0, 0xC0, 0xC0, 0xC0, 0xC0, 0xC0, 0xC0, 0xC0, 0xC0, 0xC0, 0xC0, 0xC0, 0xC0,
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0x00, 0x00, 0x00, 0x00, 0x00, 0x00, 0x00, 0x00 };

static const unsigned char PROGMEM heatVent_on[] = {
  0x00, 0x00, 0x00, 0x00, 0x00, 0x00, 0x00, 0x00, 0x00, 0x00, 0x00, 0x00, 0x00, 0x00, 0x00, 0x00,
0x00, 0x00, 0x00, 0x00, 0x00, 0x00, 0x00, 0x00, 0x00, 0x00, 0x00, 0x00, 0x00, 0x00, 0x00, 0x00,
0x00, 0x00, 0x00, 0x00, 0x00, 0x00, 0x00, 0x00, 0x00, 0x00, 0x00, 0x00, 0x00, 0x00, 0x00, 0x00,
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0x70, 0xF0, 0xF0, 0x20, 0x10, 0x40, 0x70, 0xE0, 0xE0, 0x50, 0x40, 0x00, 0xB0, 0xD0, 0x60, 0xA0 };


static const unsigned char PROGMEM flooding_on[] = {
  0x00, 0x00, 0x00, 0x00, 0x00, 0x00, 0x00, 0x00, 0x00, 0x00, 0x00, 0x00, 0x00, 0x00, 0x00, 0x00,
0x00, 0x00, 0x00, 0x00, 0x00, 0x00, 0x00, 0x00, 0x00, 0x00, 0x00, 0x00, 0x00, 0x00, 0x00, 0x00,
0x00, 0x00, 0x00, 0x00, 0x00, 0x00, 0x00, 0x00, 0x00, 0x00, 0x00, 0x00, 0x00, 0x00, 0x00, 0x00,
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0x00, 0x00, 0x00, 0x00, 0x00, 0x00, 0x00, 0x00, 0x00, 0x00, 0x00, 0x00, 0x00, 0x00, 0x00, 0x00 };


static const unsigned char PROGMEM dht11_missing [] = {
0x00, 0x00, 0x00, 0x00, 0x00, 0x00, 0x00, 0x00, 0x00, 0x00, 0x00, 0x00, 0x00, 0x00, 0x00, 0x00,
0x00, 0x00, 0x00, 0x00, 0x00, 0x00, 0x00, 0x00, 0x00, 0x00, 0x00, 0x00, 0x00, 0x00, 0x00, 0x00,
0x00, 0x00, 0x00, 0x00, 0x00, 0x00, 0x00, 0x00, 0x00, 0x00, 0x00, 0x00, 0x00, 0x00, 0x80, 0x40,
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0x00, 0x00, 0x00, 0x00, 0x00, 0x00, 0x00, 0x00, 0x00, 0x00, 0x00, 0x00, 0x00, 0x00, 0x00, 0x00
};


static const unsigned char PROGMEM fire[] = {
  0x00, 0x00, 0x00, 0x00, 0x00, 0x00, 0x00, 0x00, 0x00, 0x00, 0x00, 0x00, 0x00, 0x00, 0x00, 0x00,
0x00, 0x00, 0x00, 0x00, 0x00, 0x00, 0x00, 0x00, 0x00, 0x00, 0x00, 0x00, 0x00, 0x00, 0x00, 0x00,
0x00, 0x00, 0x00, 0x00, 0x00, 0x00, 0x00, 0x00, 0x00, 0x00, 0x00, 0x00, 0x00, 0x00, 0x00, 0x00,
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0x00, 0x00, 0x00, 0x00, 0x00, 0x00, 0x00, 0x00, 0x00, 0x00, 0x00, 0x00, 0x00, 0x00, 0x00, 0x00
};

static const unsigned char PROGMEM ice [] = {
0x00, 0x00, 0x00, 0x00, 0x00, 0x00, 0x00, 0x00, 0x00, 0x00, 0x00, 0x00, 0x00, 0x00, 0x00, 0x00,
0x00, 0x00, 0x00, 0x00, 0x00, 0x00, 0x00, 0x00, 0x00, 0x00, 0x00, 0x00, 0x00, 0x00, 0x00, 0x00,
0x00, 0x00, 0x00, 0x00, 0x00, 0x00, 0x00, 0x00, 0x00, 0x00, 0x00, 0x00, 0x00, 0x00, 0x00, 0x00,
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0x00, 0x00, 0x00, 0x00, 0x00, 0x00, 0x00, 0x00, 0x00, 0x00, 0x00, 0x00, 0x00, 0x00, 0x00, 0x00
};

static const unsigned char PROGMEM humidityHigh [] = {
0x00, 0x00, 0x00, 0x00, 0x00, 0x00, 0x00, 0x00, 0x00, 0x00, 0x00, 0x00, 0x00, 0x00, 0x00, 0x00,
0x00, 0x00, 0x00, 0x00, 0x00, 0x00, 0x00, 0x00, 0x00, 0x00, 0x00, 0x00, 0x00, 0x00, 0x00, 0x00,
0x00, 0x00, 0x00, 0x00, 0x00, 0x00, 0x00, 0x00, 0x00, 0x00, 0x00, 0x80, 0xC0, 0xC0, 0xE0, 0xF0,
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0x00, 0x00, 0x00, 0x00, 0x00, 0x00, 0x00, 0x00, 0x00, 0x00, 0x00, 0x00, 0x00, 0x00, 0x00, 0x00
};

byte y = 0;
bool statusChanged = true;
void setup()
{
  pinMode(buttonOkPin, INPUT);
  pinMode(buttonLeftPin, INPUT);
  pinMode(buttonRightPin, INPUT);
  pinMode(heater, OUTPUT);
  pinMode(vent, OUTPUT);
  pinMode(poplava, INPUT_PULLUP);
  pinMode(heaterSwitch, OUTPUT);
  pinMode(ventSwitch, OUTPUT);
  EEPROM.write(setByAmountAddr, 10);
  maxtemp = EEPROM.read(maxtempaddr);
  mintemp = EEPROM.read(mintempaddr);
  maxhum = EEPROM.read(maxhumaddr);
  heaterManual = EEPROM.read(heaterSetting);
  coolerManual = EEPROM.read(coolerSetting);

  beginSerial();
  dht.setup(DHT11Pin);
  Wire.begin(I2CAddress::Interface);  
  Wire.onReceive(receiveEvent);
  oled.init(); // Initialze SSD1306 OLED display
  oled.sendCommand(0xA1);            //SEGREMAP   Mirror screen horizontally (A0)
  oled.sendCommand(0xC8);            //COMSCANDEC Rotate screen vertically (C0)
  oled.sendCommand(0xDA);            //0xDA
  oled.sendCommand(0x12);            //COMSCANDEC
}

void loop()
{
    delay(200);
    standBy();
    delay(100);
}

void standBy(){
  bool drawn = false;
  int imgToShow = 0;
  int oldImgToShow = imgToShow;
  int countTime = 0;
  MenuState = 0;
  while(MenuState == 0 ){
    countTime++;
    buttonState = digitalRead(buttonOkPin);
    if(drawn == false || oldImgToShow != imgToShow){
      oled.clearDisplay();
      draw(imgToShow);
      drawn = true;
      oldImgToShow = imgToShow;
      delay(200);
    }
    if (buttonState == 1)
        {
            delay(100);
            testMenu();
            MenuState = 0;
            drawn = false;
        }else if(countTime >= 100){
          countTime = 0;
          imgToShow = processData();
        }else{
          delay(10);
        }
      if(digitalRead(buttonRightPin) && digitalRead(buttonLeftPin))
      {
        demo();
        drawn= false;
        counter++;
        delay(1000);
      }
  }
}

void demo(){
    readSensor();
    setByAmount = EEPROM.read(setByAmountAddr);
    byte h = humDHT+setByAmount;
    byte tH = tempDHT+setByAmount;
    byte tL = tempDHT-setByAmount;
    debugln(tH);
    EEPROM.write(maxtempaddr, tH);
    EEPROM.write(mintempaddr, tL);
    EEPROM.write(maxhumaddr, h);
    EEPROM.write(heaterSetting, false);
    EEPROM.write(coolerSetting, false);
    maxtemp = EEPROM.read(maxtempaddr);
    mintemp = EEPROM.read(mintempaddr);
    maxhum = EEPROM.read(maxhumaddr);
    heaterManual = EEPROM.read(heaterSetting);
    coolerManual = EEPROM.read(coolerSetting);
    oled.clearDisplay();              // Clear screen
    oled.drawBitmap(nothing, 1024);
    delay(500);
    oled.clearDisplay();
    oled.drawBitmap(vent_on, 1024);
    digitalWrite(vent, HIGH);
    digitalWrite(ventSwitch, HIGH);
    delay(500);
    digitalWrite(vent, LOW);
    digitalWrite(ventSwitch, LOW);
    oled.clearDisplay();
    oled.drawBitmap(heater_on, 1024);
    digitalWrite(heater, HIGH);
    digitalWrite(heaterSwitch, HIGH);
    delay(500);
    digitalWrite(heater, LOW);
    digitalWrite(heaterSwitch, LOW);
    oled.clearDisplay();
    oled.drawBitmap(heatVent_on, 1024);
    digitalWrite(heater, HIGH);
    digitalWrite(heaterSwitch, HIGH);
    digitalWrite(vent, HIGH);
    digitalWrite(ventSwitch, HIGH);
    delay(500);
    digitalWrite(vent, LOW);
    digitalWrite(ventSwitch, LOW);
    digitalWrite(heater, LOW);
    digitalWrite(heaterSwitch, LOW);
    oled.clearDisplay();
    oled.drawBitmap(sending, 1024);
    delay(500);
    oled.clearDisplay();
    oled.drawBitmap(battery, 1024);
    delay(500);
    oled.clearDisplay();
    oled.drawBitmap(flooding_on, 1024);
    delay(500);
    oled.clearDisplay();
    oled.drawBitmap(dht11_missing, 1024);
    delay(500);
    oled.clearDisplay();
    oled.drawBitmap(fire, 1024);
    delay(500);
    oled.clearDisplay();
    oled.drawBitmap(ice, 1024);
    delay(500);
    oled.clearDisplay();
    oled.drawBitmap(humidityHigh, 1024);
    delay(500);
    sendData = true;
    delay(500);
    processData();
}

void testMenu(){
  bool drawn = false;
  int countTime = 0;
  while(MenuState < 6){
    countTime++;
    if(countTime >= 500){
      MenuState = 7;   
    }else{
      delay(10);
      }
    buttonState = digitalRead(buttonOkPin);
    if (buttonState == 1)
        {
            delay(100);
            MenuState++;
            drawn = false;
            countTime = 0;
        }
      if (MenuState == 1)
      {
        if(drawn == false){
          oled.clearDisplay();
          oled.setTextXY(0,0); 
          oled.putString("SET UP:");
          oled.setTextXY(1,0); 
          oled.putString("Menu for setting up");
          oled.setTextXY(2,0); 
          oled.putString("max. and min. temp.");
          oled.setTextXY(3,0); 
          oled.putString("and max. humidity.");
          drawn = true;
          }
      }
      if (MenuState == 2)
      {
        if(drawn == false){
          oled.clearDisplay();
          oled.setTextXY(0,0); 
          oled.putString("Manual Mode:");
          oled.setTextXY(1,0); 
          oled.putString("Leave on Off for self regulation");
          oled.setTextXY(4,0); 
          heaterManual?oled.putString("Heater: On"):oled.putString("Heater: Off");
          oled.setTextXY(5,0); 
          coolerManual?oled.putString("Cooler: On"):oled.putString("Cooler: Off");
          drawn = true;
          }
          if (digitalRead(buttonRightPin) == 1){
            delay(200);
            heaterManual = !heaterManual;
            if(heaterManual){
              oled.setTextXY(4,0); 
              oled.putString("Heater: On ");
            }else{
              oled.setTextXY(4,0); 
              oled.putString("Heater: Off");
            }
          }
          if (digitalRead(buttonLeftPin) == 1){
            delay(200);
            coolerManual = !coolerManual;
            if(coolerManual){
              oled.setTextXY(5,0); 
              oled.putString("Cooler: On ");
            }else{
              oled.setTextXY(5,0); 
              oled.putString("Cooler: Off");
            }
          }
      }
      if (MenuState == 3)
        {
          if(maxtemp > 50 || maxtemp < 0){
            maxtemp = 25;
          }
          if(drawn == false){
            oled.clearDisplay();                          // 1:1 pixel
            oled.setTextXY(0,0);                            // Start at top-left corner
            oled.putString("MAX.TEMP:");
            oled.setTextXY(1,0);
            oled.setTextXY(2,0);
            oled.putString("   0 - 50 C");
            oled.setTextXY(3,0);
            oled.putString("");
            oled.setTextXY(4,0);
            oled.putString("  ");
            oled.setTextXY(4,0);
            oled.putString(itoa(maxtemp, cstr, 10));
            oled.setTextXY(4,3);
            oled.putString("C");
            drawn = true;
          }
            if (digitalRead(buttonRightPin) == 1)
            {
              countTime = 0;
                delay(200);
                if (maxtemp < 50)
                {
                    maxtemp++;
                }
                oled.setTextXY(4,0);
            oled.putString(itoa(maxtemp, cstr, 10));
            }
            if (digitalRead(buttonLeftPin) == 1)
            {
              countTime = 0;
                delay(200);
                if (maxtemp > 0)
                {
                    maxtemp--;
                }
                oled.setTextXY(4,0);
                if(maxtemp < 10){
                  oled.putString(" ");
                }
            oled.putString(itoa(maxtemp, cstr, 10));
            }
        }
        if (MenuState == 4)
        {
          if(mintemp > 40 || mintemp < 0){
            mintemp = 25;
          }
          if(drawn == false){
            oled.clearDisplay();                          // Start at top-left corner
            oled.setTextXY(0,0);
            oled.putString("MIN.TEMP:");
            oled.setTextXY(1,0);
            oled.putString("   0 - 40 C");
            oled.setTextXY(2,0);
            oled.putString("");
            oled.setTextXY(3,0);
            oled.putString("  ");
            oled.setTextXY(4,0);
            oled.putString(itoa(mintemp, cstr, 10));
            oled.setTextXY(4,3);
            oled.putString("C");
            drawn = true;
          }
            if (digitalRead(buttonRightPin) == 1)
            {
              countTime = 0;
                delay(200);
                if (mintemp < 40)
                {
                    mintemp++;
                }
                oled.setTextXY(4,0);
                if(mintemp < 10){
                  oled.putString(" ");
                }
            oled.putString(itoa(mintemp, cstr, 10));
            }
            if (digitalRead(buttonLeftPin) == 1)
            {
              countTime = 0;
                delay(200);
                if (mintemp > 0)
                {
                    mintemp--;
                }
                oled.setTextXY(4,0);
            oled.putString(itoa(mintemp, cstr, 10));
            }
        }
        if (MenuState == 5)
        {
          if(maxhum > 99 || maxhum < 0){
            maxhum = 50;
          }
          if(drawn == false){
            oled.clearDisplay();
            oled.setTextXY(0,0);
            oled.putString("MAX. HUM:");
            oled.setTextXY(1,0);
            oled.putString("   30 - 99 %");
            oled.setTextXY(2,0);
            oled.putString("");
            oled.setTextXY(3,0);
            oled.putString("  ");
            oled.setTextXY(4,0);
            oled.putString(itoa(maxhum, cstr, 10));
            oled.setTextXY(4,3);
            oled.putString("%");
            drawn = true;
          }
            if (digitalRead(buttonRightPin) == 1)
            {
              countTime = 0;
                delay(200);
                if (maxhum < 99)
                {
                    maxhum++;
                }
                oled.setTextXY(4,0);
            oled.putString(itoa(maxhum, cstr, 10));
            }
            if (digitalRead(buttonLeftPin) == 1)
            {
              countTime = 0;
                delay(200);
                if (maxhum > 30)
                {
                    maxhum--;
                }
                oled.setTextXY(4,0);
            oled.putString(itoa(maxhum, cstr, 10));
            }
        }
        if (MenuState == 6)
        {
          if(drawn == false){
            EEPROM.write(maxhumaddr, maxhum);
            EEPROM.write(mintempaddr, mintemp);
            EEPROM.write(maxtempaddr, maxtemp);
            EEPROM.write(heaterSetting, heaterManual);
            EEPROM.write(coolerSetting, coolerManual);
            drawn = true;
          }
          oled.clearDisplay();
            oled.putString("          ");
            oled.putString(" SETTINGS ");
            oled.putString("  SAVED!  ");
            oled.putString("          ");
            delay(700);
            oled.clearDisplay();
            oled.putString("          ");
            oled.putString(" SETTINGS ");
            oled.putString("  SAVED!  ");
            oled.putString("          ");
            delay(700);
            MenuState++;
        }
  }
}

void draw(int imageToShow){
  switch(imageToShow){
    case 1:
      drawHeaterOn();
      break;
    case 2: 
      drawCoolerOn();
      break;
    case 3: 
      drawSending();
      break;
    case 4:
     drawBattery();
     break;
   case 5:
     drawHeatVent();
     break;
   case 6:
     drawFlooding();
     break;
   case 7:
     drawDht11Missing();
     break;
   case 8:
     drawFire();
     break;
   case 9: 
     drawIce();
     break;
   case 10:
     drawHum();
     break;
    default:
      drawCompanyLogo();          
  }
}

void drawCompanyLogo(){
  oled.drawBitmap(nothing, 1024);
}

void drawHeaterOn(void)
{
    oled.drawBitmap(heater_on, 1024);
}

void drawCoolerOn(void)
{
    oled.drawBitmap(vent_on, 1024);
}

void drawSending(void)
{
    oled.drawBitmap(sending, 1024);
}

void drawBattery(void)
{
    oled.drawBitmap(battery, 1024);
}

void drawHeatVent(void)
{
    oled.drawBitmap(heatVent_on, 1024);
}

void drawFlooding(void){
    oled.drawBitmap(flooding_on, 1024);
}

void drawDht11Missing(void){
  oled.drawBitmap(dht11_missing, 1024);
}

void drawFire(void){
  oled.drawBitmap(fire, 1024);
}

void drawIce(void){
  oled.drawBitmap(ice, 1024);
}

void drawHum(void){
  oled.drawBitmap(humidityHigh, 1024);
}

int processData()
{
    int imgToShow = 0;
    bool vlaga = false;
    bool underWater = !digitalRead(poplava);
    dhtError += readSensor();
    if(dhtError > 5){
      imgToShow = 7;
      return imgToShow;
    }

    if(tempDHT > maxTempLimit){
      imgToShow = 8;
      return imgToShow;
    }else if(tempDHT < minTempLimit){
      imgToShow = 9;
      return imgToShow;
    }else if(humDHT > maxHumLimit){
      imgToShow = 10;
      return imgToShow;
    }
    
    if (humDHT > maxhum && !underWater)
    {
      if (digitalRead(heater)==0)
        {
          digitalWrite(heater, HIGH);
          debugln("HEATON");
        }
      if (digitalRead(vent)==0){
          digitalWrite(vent,HIGH);  
          debugln("VENTON");
        }
        imgToShow = 5;
        vlaga = true;
    }else if (humDHT <= maxhum)
    {
      vlaga = false;
    }


    if (tempDHT < mintemp && !vlaga)
    {
        imgToShow = 1;
        if (digitalRead(heater)==0)
        {
          digitalWrite(heater, HIGH);
          debugln("HEATON");
        }
    }else
    if (tempDHT >= mintemp && !vlaga)
    {
      imgToShow = 0;
      if (digitalRead(heater) == 1)
      {
          digitalWrite(heater, LOW);
          debugln("HEATOFF");  
      }
    }
    if (tempDHT > maxtemp && !vlaga)
    {
        imgToShow = 2;
        if (digitalRead(vent)==0){
          digitalWrite(vent,HIGH);  
          debugln("VENTON");
        }
    }else
    if (tempDHT <= maxtemp && !vlaga)
    {
      if(digitalRead(heater)==0){
        imgToShow = 0;  
      }
        if (digitalRead(vent)==1){
        digitalWrite(vent,LOW);  
        debugln("VENTOFF");
        }
    }
    if(onBattery){
      imgToShow = 4;
    }
    if(underWater){
      imgToShow = 6;
      digitalWrite(heater, LOW);
      digitalWrite(vent, LOW);
    }
    debug("H: ");
    debug(humDHT);
    debug("% ");
    debug(" T: ");
    debug(tempDHT);
    debugln("C");
    debugln(String("VentStatus: ")+String(digitalRead(vent)));
    if(sendData){
      byte toSend[7] = {I2CAddress::Interface, digitalRead(heater), digitalRead(vent), underWater, tempDHT, humDHT, sendData};
      Wire.beginTransmission(I2CAddress::Controller);
      for(int i = 0; i < 7;i++){
        Wire.write(toSend[i]);
      }
      Wire.endTransmission();
      // imgToShow = 3;
      sendData = false;
    }
    if((digitalRead(heater) || heaterManual) && !underWater){
      countHeaterStatus++;
      digitalWrite(heaterSwitch, HIGH);
    }else{
      countHeaterStatus++;
      digitalWrite(heaterSwitch, LOW);
    }
    if((digitalRead(vent) || coolerManual) && !underWater){
      countVentStatus++;
      digitalWrite(ventSwitch, HIGH);
    }else{
      countVentStatus++;
      digitalWrite(ventSwitch, LOW);
    }
    if(millis() - prevMillisOfStatus >= 5000){
      countHeaterStatus = 0;
      countVentStatus = 0;
      prevMillisOfStatus = millis();
    }else{
      if(countHeaterStatus > 5 && countVentStatus < 5){
        maxtemp += 5;
      }
      if(countVentStatus > 5 && countHeaterStatus < 5){
        mintemp -= 5;
      }
      if(countHeaterStatus > 5 && countVentStatus > 5){
        maxhum += 5;
      }
    }
    return imgToShow;
 }



bool readSensor()
{
  // Make sure we don't poll the sensor too often
  // - Max sample rate DHT11 is 1 Hz   (duty cicle 1000 ms)
  // - Max sample rate DHT22 is 0.5 Hz (duty cicle 2000 ms)
  if(millis() - prevMillis >= 1000){
    prevMillis = millis();
  }else{
    return false;
  }
  unsigned long startTime = millis();
  // Request sample

  digitalWrite(DHT11Pin, LOW); // Send start signal
  pinMode(DHT11Pin, OUTPUT);
  delay(18);

  pinMode(DHT11Pin, INPUT);
  digitalWrite(DHT11Pin, HIGH); // Switch bus to receive data

  // We're going to read 83 edges:
  // - First a FALLING, RISING, and FALLING edge for the start bit
  // - Then 40 bits: RISING and then a FALLING edge per bit
  // To keep our code simple, we accept any HIGH or LOW reading if it's max 85 usecs long

  uint16_t rawHumidity = 0;
  uint16_t rawTemperature = 0;
  uint16_t data = 0;

  for ( int8_t i = -3 ; i < 2 * 40; i++ ) {
    byte age;
    startTime = micros();

    do {
      age = (unsigned long)(micros() - startTime);
      if ( age > 90 ) {
        //error = ERROR_TIMEOUT;
        return true;
      }
    }
    while ( digitalRead(DHT11Pin) == (i & 1) ? HIGH : LOW );

    if ( i >= 0 && (i & 1) ) {
      // Now we are being fed our 40 bits
      data <<= 1;

      // A zero max 30 usecs, a one at least 68 usecs.
      if ( age > 30 ) {
        data |= 1; // we got a one
      }
    }

    switch ( i ) {
      case 31:
        rawHumidity = data;
        break;
      case 63:
        rawTemperature = data;
        data = 0;
        break;
    }
  }

  if ( (byte)(((byte)rawHumidity) + (rawHumidity >> 8) + ((byte)rawTemperature) + (rawTemperature >> 8)) != data ) {
    //error = ERROR_CHECKSUM;
    return true;
  }

  // Store readings

  humDHT = rawHumidity >> 8;
  tempDHT = rawTemperature >> 8;
  dhtError = 0;
  return false;
}

void receiveEvent(int howMany)
{
  if(Wire.available()){
    switch(Wire.read()){
      case I2CAddress::Controller:
        onBattery = Wire.read();
        sendData = true;
      break;
    }
  }
}

 
